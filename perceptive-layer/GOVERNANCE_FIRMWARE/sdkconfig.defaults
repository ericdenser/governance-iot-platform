## perceptive-layer/mqtt_protobuff/FIRM_PROVISIONING_MQTT_PROTOBUFF/main/Kconfig.projbuild
```kconfig
menu "WiFi Manager Configuration"

    config WIFI_SSID
        string "Main SSID"
        default "Myssid"

    config WIFI_PASSWORD
        string "Main Password"
        default "Mypassword"

    config WIFI_MAX_RETRIES
        int "Max Retries"
        default 5

    choice WIFI_FAILURE_STRATEGY
        prompt "Recovery Strategy on Failure"
        default WIFI_RECOVERY_RESET
        help
            Define o comportamento quando o número máximo de tentativas é atingido.

        config WIFI_RECOVERY_RESET
            bool "System Reset"
            help
                Reinicia o ESP32 automaticamente (esp_restart).

        config WIFI_RECOVERY_SWAP
            bool "Swap SSID (Try Backup Network)"
            help
                Tenta conectar em uma rede secundária definida abaixo.
                Se a rede secundária também falhar, o sistema reinicia.

        config WIFI_RECOVERY_NONE
            bool "Keep Idle (Manual Handling)"
            help
                Apenas para o driver e define o estado como FAILED.
                A aplicação deve decidir o que fazer.
    endchoice

    # CREDENCIAIS DE BACKUP (Só aparecem se SWAP for escolhido)
    config WIFI_BACKUP_SSID
        string "Backup SSID"
        depends on WIFI_RECOVERY_SWAP
        default "Backup_Network"

    config WIFI_BACKUP_PASSWORD
        string "Backup Password"
        depends on WIFI_RECOVERY_SWAP
        default ""

endmenu

menu "Governance IoT"

    config GOV_MQTT_BROKER_URI
        string "MQTT Broker URI"
        default "mqtt://REPLACE_ME:1883"
        help
            URI completa do broker MQTT. O esquema define o transporte:
              mqtt://host:8883        — TLS direto
              wss://host:1883         — MQTT-over-Websocket
            Exemplos:
              mqtt://192.168.15.76:1883 (dev local)
              wss://iot.mackenzie.br/mqtt (prod via websocket)

    config GOV_MDM_BASE_URL
        string "MDM (govApi) base URL"
        default "http://xxx.xxx.xx.xx:8080"
        help
            URL base do govApi, SEM barra final. Os endpoints
            (/provisioning/activate etc) são concatenados pelo firmware.
            Exemplos:
              http://xxx.xxx.xx.xx:8080
              https://mackenzie.br/apps/govApi
              https://iot.mackenzie.br

     config GOV_KEYCLOAK_URL
        string "Keycloak base URL"
        default "http://REPLACE_ME:8080"
        help
            Base URL do Keycloak (SEM /realms/... no final).
            Alt B usa esta URL pra obter JWT via client_credentials.
            Exemplos:
              http://mackleaps.mackenzie.br/keycloak
              http://192.168.15.76:8080

    config GOV_KEYCLOAK_REALM
        string "Keycloak realm"
        default "IOT-REALM"
        help
            Realm onde os device-clients existem.

    config GOV_KC_TOKEN_MARGIN_S
        int "JWT renewal margin (seconds)"
        default 300
        range 30 1800
        help
            Margem de segurança antes do exp: renova JWT quando faltar
            menos que isso pra expirar. Default 300 (5min) evita usar
            token que expira durante o handshake MQTT.

endmenu
```
