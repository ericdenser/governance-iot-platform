## perceptive-layer/mqtt_protobuff/FIRM_OPERATIONAL_MQTT_PROTOBUFF/main/Kconfig.projbuild
```kconfig
menu "Display LCD (ST7789 SPI)"

    config GOV_LCD_ENABLED
        bool "Display conectado"
        default y
        help
            Desmarcado, o firmware nao inclui LVGL, telas, botao nem captura de log.

    if GOV_LCD_ENABLED

    config GOV_LCD_PIN_SCLK
        int "SCLK GPIO"
        default 12

    config GOV_LCD_PIN_MOSI
        int "MOSI (SDA) GPIO"
        default 11

    config GOV_LCD_PIN_CS
        int "CS GPIO"
        default 14

    config GOV_LCD_PIN_DC
        int "DC GPIO"
        default 13

    config GOV_LCD_PIN_RST
        int "RST GPIO (-1 se nao usado)"
        default 10

    config GOV_LCD_PIN_BL
        int "Backlight GPIO (-1 se ligado no VCC)"
        default -1

    config GOV_LCD_INVERT_COLOR
        bool "Inverter cores"
        default y

    endif

endmenu

menu "Interface (botao e telas)"
    depends on GOV_LCD_ENABLED

    config GOV_UI_BUTTON_GPIO
        int "GPIO do botao (entre o pino e GND)"
        default 15

    config GOV_UI_AUTO_DASHBOARD_MS
        int "Espera (ms) apos OPERATIONAL antes de ir pro dashboard"
        default 4000

    config GOV_UI_UTC_OFFSET_MIN
        int "Fuso horario exibido, em minutos (Brasilia = -180)"
        range -720 840
        default -180

endmenu
```

## perceptive-layer/mqtt_protobuff/FIRM_OPERATIONAL_MQTT_PROTOBUFF/sdkconfig.defaults.mackcloud
```kconfig
# idf.py -D SDKCONFIG_DEFAULTS="sdkconfig.defaults;sdkconfig.defaults.mackcloud" build

CONFIG_GOV_KEYCLOAK_URL="https://mackleaps.mackenzie.br/keycloak"
CONFIG_GOV_KEYCLOAK_REALM="IOT-REALM"
CONFIG_GOV_MDM_BASE_URL="https://mackleaps.mackenzie.br/IOT/govapi"
CONFIG_GOV_MQTT_BROKER_URI="wss://mackleaps.mackenzie.br/IOT/mqtt"
CONFIG_GOV_KC_TOKEN_MARGIN_S=300
```

## perceptive-layer/mqtt_protobuff/gov_plugins/gov_hal/Kconfig
```kconfig
menu "Governance - barramento I2C dos sensores"

    config GOV_I2C_SDA_PIN
        int "GPIO SDA"
        default 8

    config GOV_I2C_SCL_PIN
        int "GPIO SCL"
        default 9

endmenu
```

## perceptive-layer/mqtt_protobuff/gov_plugins/gov_hal/Kconfig.projbuild
```kconfig
menu "Sensores: barramento I2C"

    config GOV_I2C_SDA_PIN
        int "GPIO SDA"
        default 8

    config GOV_I2C_SCL_PIN
        int "GPIO SCL"
        default 9

endmenu
```

## perceptive-layer/mqtt_protobuff/gov_plugins/gov_sensor_aht25/Kconfig.projbuild
```kconfig
menu "Sensor: AHT25"

    config GOV_SENSOR_AHT25
        bool "Sensor AHT25 (I2C 0x38)"
        default y
        help
            Code "aht25". Metrics: temperature and humidity (%RH).

endmenu
```

## perceptive-layer/mqtt_protobuff/gov_plugins/gov_sensor_battery/Kconfig
```kconfig
menu "Governance - bateria (ADC)"

    config GOV_SENSOR_BATTERY
        bool "Medir bateria pelo ADC"
        default y
        help
            Code "battery_adc". Metric: battery_mv.

    config GOV_BAT_GPIO
        int "GPIO do divisor da bateria (ADC1: GPIO1..GPIO10)"
        default 4

    config GOV_BAT_DIVIDER_X100
        int "Fator do divisor x100"
        default 202
        help
            Tensao real = tensao no pino * fator/100 (ex: 5V viram ~2.5V no pino -> 202).

    config GOV_BAT_MIN_VALID_MV
        int "Abaixo disso (mV) a leitura e tratada como invalida"
        default 2600

endmenu
```

## perceptive-layer/mqtt_protobuff/gov_plugins/gov_sensor_bmp280/Kconfig
```kconfig
config GOV_SENSOR_BMP280
    bool "Sensor BMP280/BME280 (I2C 0x76/0x77)"
    default y
    help
        Code "bmp280". Metrics: temperature, pressure (hPa) and humidity (BME280 only).
```

## perceptive-layer/mqtt_protobuff/gov_plugins/gov_sensor_chip_temp/Kconfig
```kconfig
config GOV_SENSOR_CHIP_TEMP
    bool "Temperatura interna do chip"
    default y
    help
        Code "chip_temp". Metric: temp_c (used by the platform HIGH_TEMP health check).
```

## perceptive-layer/mqtt_protobuff/gov_plugins/gov_sensor_ds3231/Kconfig
```kconfig
config GOV_SENSOR_DS3231
    bool "RTC DS3231 (I2C 0x68)"
    default y
    help
        Code "ds3231". No telemetry; keeps the time between boots (time sync hooks).
```

## perceptive-layer/mqtt_protobuff/gov_plugins/gov_sensor_env/Kconfig.projbuild
```kconfig
menu "Sensor: fusao BMP280 + AHT25"

    config GOV_SENSOR_ENV
        bool "Enviar temperatura e umidade combinadas do BMP280 e do AHT25"
        default n
        help
            Code "env" (derivado). BMP280 e AHT25 continuam detectados, mas a
            telemetria leva so temperature, humidity e pressure da fusao.

    config GOV_ENV_TEMP_OUTLIER_X10
        int "Divergencia maxima de temperatura entre sensores (decimos de C)"
        default 30
        depends on GOV_SENSOR_ENV
        help
            Acima disso, o sensor mais longe da mediana recente e descartado
            naquela amostra. 30 = 3.0 C.

    config GOV_ENV_HUM_OUTLIER_X10
        int "Divergencia maxima de umidade entre sensores (decimos de %RH)"
        default 100
        depends on GOV_SENSOR_ENV
        help
            So tem efeito com BME280 + AHT25 (BMP280 nao mede umidade).

endmenu
```

## perceptive-layer/mqtt_protobuff/gov_plugins/gov_sensor_flow/Kconfig.projbuild
```kconfig
menu "Sensor: fluxo de agua (pulsos)"

    config GOV_SENSOR_FLOW
        bool "Sensor de fluxo por pulsos (YF-B6 e similares)"
        default n
        help
            Code "flow". Metrics: flow_lpm (vazao media desde a telemetria anterior)
            e volume_l (total desde o boot). Nao da para detectar o sensor pelo pino:
            habilitado, ele sempre aparece como ativo.

    config GOV_SENSOR_FLOW_GPIO
        int "GPIO do sinal (fio amarelo)"
        range 0 48
        default 16
        depends on GOV_SENSOR_FLOW
        help
            Alimentado em 5V, o sinal sai em 5V: use conversor de nivel ou divisor
            e confira que o pino nao passa de 3.3V. Nao use GPIO de outro sensor.

    config GOV_SENSOR_FLOW_K_X100
        int "Fator K x100 (Hz por L/min)"
        range 1 100000
        default 660
        depends on GOV_SENSOR_FLOW
        help
            Datasheet: F(Hz) = K x Q(L/min). YF-B6: K = 6.6 -> 660 (396 pulsos por litro).
            YF-S201: K = 7.5 -> 750.

endmenu
```

## perceptive-layer/mqtt_protobuff/gov_plugins/gov_sensor_gps/Kconfig.projbuild
```kconfig
menu "Sensor: GPS"

    config GOV_SENSOR_GPS
        bool "GPS instalado"
        default y
        help
            Code "gps". Metrics: latitude, longitude, altitude (only with a fix).

    config GOV_GPS_POWER_PIN
        int "GPIO de alimentacao do GPS (transistor)"
        default 5
        help
            Nivel 1 = GPS ligado, 0 = desligado.

    config GOV_GPS_UART_TX_PIN
        int "UART TX GPIO (ESP TX -> GPS RX)"
        default 17

    config GOV_GPS_UART_RX_PIN
        int "UART RX GPIO (ESP RX <- GPS TX)"
        default 18

    config GOV_GPS_UART_PORT
        int "Porta UART"
        default 1

endmenu
```

## perceptive-layer/mqtt_protobuff/gov_plugins/gov_sensor_mq135/Kconfig.projbuild
```kconfig
menu "Sensor: MQ135 (qualidade do ar)"

    config GOV_MQ135_ENABLED
        bool "MQ135 instalado"
        default y
        help
            Code "mq135". Metric: co2_ppm (only after the warm-up).

    config GOV_MQ135_GPIO
        int "GPIO do AO (ADC1: GPIO1..GPIO10)"
        default 6
        depends on GOV_MQ135_ENABLED

    config GOV_MQ135_DIVIDER_X100
        int "Fator do divisor x100 (10k/10k = 200, 10k/20k = 150)"
        default 150
        depends on GOV_MQ135_ENABLED

    config GOV_MQ135_RL_OHM
        int "RL do modulo (ohm)"
        default 10000
        depends on GOV_MQ135_ENABLED

    config GOV_MQ135_R0_OHM
        int "R0 calibrado em ar limpo (ohm)"
        default 76630
        depends on GOV_MQ135_ENABLED

    config GOV_MQ135_WARMUP_S
        int "Aquecimento apos ligar (s)"
        default 120
        depends on GOV_MQ135_ENABLED

endmenu
```
